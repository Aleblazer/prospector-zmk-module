## Kconfig
```kconfig
choice PROSPECTOR_STATUS_SCREEN_LAYOUT
    prompt "Status screen layout"
    default PROSPECTOR_STATUS_SCREEN_CLASSIC

config PROSPECTOR_STATUS_SCREEN_CLASSIC
    bool "Classic layout"
    help
        Standard Prospector status screen

config PROSPECTOR_STATUS_SCREEN_RADII
    bool "Radii layout"
    help
        Colorful grid layout with rounded widgets

config PROSPECTOR_STATUS_SCREEN_FIELD
    bool "Field layout"
    help
        Minimal layout with flowing typing activity visualization

config PROSPECTOR_STATUS_SCREEN_OPERATOR
    bool "Operator layout"
    help
        Technical and information dense layout

endchoice

config PROSPECTOR_ROTATE_DISPLAY_180
    bool "Rotate the display 180 degrees"
    default n

config PROSPECTOR_SHOW_MODIFIERS
    bool "Display modifier key indicators (Cmd, Opt, Ctrl, Shift)"
    default y

config PROSPECTOR_SHOW_INACTIVE_MODIFIERS
    bool "Show inactive modifier indicators (dim when not pressed)"
    default y
    depends on PROSPECTOR_SHOW_MODIFIERS
    help
      When enabled, inactive modifiers are shown with a dim color.
      When disabled, inactive modifiers are hidden completely.
      Only affects classic and field layouts.

config PROSPECTOR_MODIFIER_ORDER
    string "Modifier display order"
    default "GACS"
    depends on PROSPECTOR_SHOW_MODIFIERS
    help
      Order of modifier indicators. Use exactly 4 characters:
      G=GUI/Cmd, A=Alt/Opt, C=Control, S=Shift.
      Each character must appear exactly once.

choice PROSPECTOR_MODIFIER_OS
    prompt "Modifier key style"
    default PROSPECTOR_MODIFIER_OS_MAC
    depends on PROSPECTOR_SHOW_MODIFIERS

config PROSPECTOR_MODIFIER_OS_GENERIC
    bool "Generic (CTRL, ALT, GUI, SHFT)"

config PROSPECTOR_MODIFIER_OS_WINDOWS
    bool "Windows"

config PROSPECTOR_MODIFIER_OS_MAC
    bool "Mac"

endchoice

config PROSPECTOR_USE_AMBIENT_LIGHT_SENSOR
    bool "Use ambient light sensor for auto brightness"
    default y

config PROSPECTOR_FIXED_BRIGHTNESS
    int "Fixed display brightness"
    default 50
    range 1 100
    depends on !PROSPECTOR_USE_AMBIENT_LIGHT_SENSOR

config PROSPECTOR_LAYER_NAME_UPPERCASE
    bool "Display layer names in uppercase"
    default y
    help
      When enabled, layer names will be converted to uppercase for display.

config PROSPECTOR_DEMO_WPM
    bool "Animate the status screen with a synthetic typing rhythm"
    default n
    help
      Drive the layout's WPM-dependent animation from a built-in rise and
      fall instead of real typing, so the panel can be judged in motion with
      nothing paired to the dongle. Operator's meter sweeps continuously;
      Field ramps up and down and then rests at zero for half a period, so
      its fade after typing stops is visible too; Classic, which has no WPM
      animation, steps its layer carousel along every 2.5 seconds instead.
      Real WPM and layer events are ignored while this is on. For bring-up
      and photography, not for normal use.

config PROSPECTOR_DEMO_WPM_PERIOD_MS
    int "Seconds per full rise and fall, in milliseconds"
    default 6000
    range 1000 60000
    depends on PROSPECTOR_DEMO_WPM
    help
      One full sweep from zero to the top of the scale and back.
```

## drivers/display/Kconfig
```kconfig
# NV3007 display driver configuration options
# SPDX-License-Identifier: Apache-2.0

menuconfig NV3007
	bool "NV3007 TFT LCD display driver"
	default y
	depends on DISPLAY
	depends on DT_HAS_NEWVISION_NV3007_ENABLED
	select MIPI_DBI
	help
	  Enable the driver for the NewVision NV3007 168x428 RGB TFT LCD
	  controller (4-wire SPI via the MIPI DBI API). Used by the 2.79"
	  142x428 IPS bar panels (e.g. EastRising ER-TFT2.79-1).

if NV3007

config NV3007_RESET_HOLD_MS
	int "Hardware reset pulse width (ms)"
	default 10
	help
	  How long the reset line is asserted when a reset GPIO is available on
	  the MIPI DBI bus.

config NV3007_RESET_RECOVERY_MS
	int "Delay after reset before sending commands (ms)"
	default 120

config NV3007_SLEEP_OUT_DELAY_MS
	int "Delay after Sleep Out before Display On (ms)"
	default 220
	help
	  The vendor sequence asks for 220 ms. Sleep Out is issued twice, once
	  to wake the controller before its registers are programmed and once
	  after, so this dominates the driver's startup time.

config NV3007_CLEAR_ON_INIT
	bool "Clear the whole frame memory during init"
	default y
	help
	  The glass is narrower than the controller's frame memory, so the
	  columns outside the visible window keep whatever they powered up
	  with and the panel displays them as a fringe of noise along one
	  edge. The application only ever draws inside the window, so clear
	  everything once at init. Costs one full frame of writes at startup.

config NV3007_INIT_F9
	bool "Send F1=0Eh and F9=17h separately (LVGL / Arduino_GFX init)"
	default y
	help
	  The EastRising demo writes F1 0E followed by a bare 17h with the F9
	  command commented out, so the 17h lands as a second F1 parameter.
	  LVGL and Arduino_GFX send F9 17 as its own command instead.

	  The datasheet defines F1 as pol_switch[7:0], a single byte that sets
	  where the polarity signal changes over, and the registers beside it
	  address the first and last half of the source enable and precharge
	  signals separately. A wrong changeover point therefore shows up as
	  banding confined to one half of the panel, which is what this fixed
	  on the 2.79" panel it was developed against. Turn it off to get the
	  literal vendor behaviour.

endif # NV3007
```

## dts/bindings/display/newvision,nv3007.yaml
```yaml
# Copyright (c) 2026 Aleblazer
# SPDX-License-Identifier: Apache-2.0

description: |
  NewVision NV3007 TFT LCD controller (168RGB x 428 frame memory) on a
  MIPI DBI (4-wire SPI) bus. Typically driving 2.79" 142x428 IPS bar panels.

  Example (Pro Micro footprint, display on the hardware SPI):

    mipi_dbi {
        compatible = "zephyr,mipi-dbi-spi";
        spi-dev = <&pro_micro_spi>;
        dc-gpios = <&pro_micro_d 6 GPIO_ACTIVE_HIGH>;
        reset-gpios = <&pro_micro_d 5 GPIO_ACTIVE_LOW>;
        write-only;
        #address-cells = <1>;
        #size-cells = <0>;

        nv3007: nv3007@0 {
            compatible = "newvision,nv3007";
            reg = <0>;
            mipi-max-frequency = <8000000>;
            mipi-mode = "MIPI_DBI_MODE_SPI_4WIRE";
            width = <142>;
            height = <428>;
            rotation = <270>;
        };
    };

compatible: "newvision,nv3007"

include: [mipi-dbi-spi-device.yaml, display-controller.yaml]

properties:
  mipi-mode:
    required: true

  gram-width:
    type: int
    default: 168
    description: |
      Number of columns in the controller frame memory (native, portrait
      orientation). The NV3007 has 168 source columns.

  gram-height:
    type: int
    default: 428
    description: |
      Number of rows in the controller frame memory (native orientation).

  x-offset:
    type: int
    default: 12
    description: |
      Column offset of the first visible panel pixel inside the frame memory,
      in the native (MADCTL = 0) orientation. For the 142-wide 2.79" panels
      the glass is centred in the 168-column GRAM with 12 unused columns on
      the left and 14 on the right; the driver derives the mirrored offset
      from gram-width, width and this value.

  y-offset:
    type: int
    default: 0
    description: |
      Row offset of the first visible panel pixel inside the frame memory,
      in the native orientation.

  rotation:
    type: int
    default: 0
    enum: [0, 90, 180, 270]
    description: |
      Initial display orientation applied during driver init. 0 is the
      panel's native portrait orientation (142 wide x 428 tall). 90 and 270
      swap the reported resolution to 428 x 142 (landscape), 180 is
      upside-down portrait. The orientation can also be changed at runtime
      with display_set_orientation().

  bgr:
    type: boolean
    description: |
      Set the MADCTL BGR bit (panel colour filter order is BGR). Leave unset
      for the ER-TFT2.79-1 which is wired RGB.

  inversion-on:
    type: boolean
    description: |
      Enable display colour inversion (INVON, 21h) after init. Some panel
      modules built on the NV3007 need this to show correct colours.

  extra-init-cmds:
    type: uint8-array
    description: |
      Extra controller commands appended to the built-in init sequence, in
      the same form it uses: a command byte, a parameter count, then that
      many parameter bytes, repeated. Sent after the vendor register page is
      closed and before Sleep Out, so any register can be overridden without
      touching driver code.

      Panel tuning lives here. The source control block at E9 through F2 sets
      the drive polarity and the source enable window, and its correct values
      vary between panels built on this controller; wrong ones show up as
      banding confined to one half of the display. E9 is the polarity control
      byte, carrying pol_ctrl, pol_init, odd_even_ctrl and pol_ctrl2, which
      the vendor sequence sets to 29h against a chip default of 20h.

      For example, to try the chip default polarity instead:

          extra-init-cmds = [ E9 01 20 ];

  ready-time-ms:
    type: int
    default: 40
    description: |
      Time from power-up until the controller accepts commands. The driver
      waits until this many ms after boot before starting the init sequence.
```
